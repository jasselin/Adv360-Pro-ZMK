msl: mod_sticky_layer {
    compatible = "zmk,behavior-hold-tap";
    label = "MOD_STICKY_LAYER";
    #binding-cells = <2>;
    flavor = "tap-preferred";
    tapping-term-ms = <200>;
    bindings =
        <&kp>,
        <&sl>;
};
